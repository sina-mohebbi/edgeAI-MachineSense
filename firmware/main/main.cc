// Phase 2 replay-mode entry point: a 3-stage FreeRTOS pipeline.
//
//   rx_task  --[vector queue]-->  infer_task  --[result queue]-->  tx_task
//   read 2560B                    quantize+invoke+                 write 12B
//   float vector                  threshold -> anomaly             reply
//
// This is the same replay protocol as Phase 1 (host streams held-out MIMII
// vectors, no sensor needed), restructured into decoupled tasks + queues so it
// mirrors how a live-sensor build would be organized (sample -> infer ->
// report) and exercises real FreeRTOS concurrency. The host stays synchronous
// (one request, wait for its reply), so at most one vector is in flight, but
// the structure is what matters.
//
// Protocol:
//   host  -> device : 640 float32 LE (2560 bytes) -- one normalized log-mel vector
//   device -> host  : 12 bytes -- float32 score, uint32 anomaly flag (0/1),
//                                 uint32 byte-sum checksum of the received request
//
// The anomaly flag is score > kAnomalyThreshold (from ml/compute_threshold.py);
// the onboard LED mirrors it. The checksum lets the host verify the request
// arrived byte-exact -- it caught the UART CR<->LF translation bug in Phase 1,
// fixed below via uart_vfs_dev_port_set_*_line_endings.
//
// esp_log stays OFF once the loop starts: it shares this UART with the binary
// protocol and would corrupt it.
#include <cstdint>
#include <cstdio>

#include "driver/gpio.h"       // gpio_* (LED)
#include "driver/uart.h"       // UART_NUM_0
#include "driver/uart_vfs.h"   // uart_vfs_dev_port_set_*_line_endings
#include "esp_log.h"
#include "freertos/FreeRTOS.h"
#include "freertos/queue.h"
#include "freertos/task.h"
#include "inference.h"
#include "threshold.h"         // kAnomalyThreshold (generated by compute_threshold.py)

namespace {

constexpr int kVectorLen = 640;                       // == config.FEATURE_DIM
constexpr int kVectorBytes = kVectorLen * sizeof(float);
constexpr gpio_num_t kAnomalyLed = GPIO_NUM_2;        // onboard LED on most DevKits
constexpr int kLatencyIterations = 100;               // boot-time inference benchmark

struct WorkItem {
  float vec[kVectorLen];
  uint32_t checksum;
};

struct Result {
  float score;
  uint32_t anomaly;
  uint32_t checksum;
};

QueueHandle_t g_vector_queue = nullptr;
QueueHandle_t g_result_queue = nullptr;

uint32_t Checksum(const uint8_t* data, int len) {
  uint32_t sum = 0;
  for (int i = 0; i < len; i++) sum += data[i];
  return sum;
}

// Stage 1: read one full float32 vector from stdin, checksum it, enqueue it.
void rx_task(void*) {
  WorkItem item;
  auto* bytes = reinterpret_cast<uint8_t*>(item.vec);
  while (true) {
    int received = 0;
    while (received < kVectorBytes) {
      int n = fread(bytes + received, 1, kVectorBytes - received, stdin);
      if (n <= 0) {
        // UART VFS read is non-blocking; yield so idle runs and the Task
        // Watchdog stays fed instead of busy-spinning (Phase 1 bug).
        vTaskDelay(1);
        continue;
      }
      received += n;
    }
    item.checksum = Checksum(bytes, kVectorBytes);
    xQueueSend(g_vector_queue, &item, portMAX_DELAY);
  }
}

// Stage 2: run inference, apply the anomaly threshold, drive the LED, enqueue result.
void infer_task(void*) {
  WorkItem item;
  while (true) {
    xQueueReceive(g_vector_queue, &item, portMAX_DELAY);
    Result result;
    result.checksum = item.checksum;
    float mse = -1.0f;
    if (inference::RunOnFloatVector(item.vec, kVectorLen, &mse)) {
      result.score = mse;
      result.anomaly = (mse > kAnomalyThreshold) ? 1u : 0u;
    } else {
      result.score = -1.0f;  // sentinel: host treats a negative score as an error
      result.anomaly = 0u;
    }
    gpio_set_level(kAnomalyLed, result.anomaly);
    xQueueSend(g_result_queue, &result, portMAX_DELAY);
  }
}

// Stage 3: write the 12-byte reply.
void tx_task(void*) {
  Result result;
  while (true) {
    xQueueReceive(g_result_queue, &result, portMAX_DELAY);
    fwrite(&result.score, sizeof(result.score), 1, stdout);
    fwrite(&result.anomaly, sizeof(result.anomaly), 1, stdout);
    fwrite(&result.checksum, sizeof(result.checksum), 1, stdout);
    fflush(stdout);
  }
}

}  // namespace

extern "C" void app_main(void) {
  if (!inference::Init()) {
    ESP_LOGE("main", "inference::Init() failed -- halting");
    return;
  }
  if (inference::FloatInputSize() != kVectorLen) {
    ESP_LOGE("main", "model input %d != expected %d -- halting",
             inference::FloatInputSize(), kVectorLen);
    return;
  }

  gpio_reset_pin(kAnomalyLed);
  gpio_set_direction(kAnomalyLed, GPIO_MODE_OUTPUT);
  gpio_set_level(kAnomalyLed, 0);

  // Pure-compute inference cost, measured before the protocol starts. The
  // host-side replay rate is UART-bound and says nothing about inference speed,
  // so this is the number that shows the model meets a real-time budget.
  float mean_us = 0.0f, min_us = 0.0f, max_us = 0.0f;
  if (inference::BenchmarkLatency(kLatencyIterations, &mean_us, &min_us, &max_us)) {
    printf("MACHINESENSE_LATENCY iters=%d mean_us=%.1f min_us=%.1f max_us=%.1f\n",
           kLatencyIterations, mean_us, min_us, max_us);
    fflush(stdout);
  }

  // Marker printed BEFORE logs are muted so a terminal can confirm boot; the
  // host waits for this line before streaming binary frames.
  printf("MACHINESENSE_READY vector_len=%d threshold=%.6f\n",
         kVectorLen, kAnomalyThreshold);
  fflush(stdout);

  esp_log_level_set("*", ESP_LOG_NONE);
  setvbuf(stdin, nullptr, _IONBF, 0);
  setvbuf(stdout, nullptr, _IONBF, 0);

  // Disable UART CR<->LF line-ending translation so the binary stream is exact.
  uart_vfs_dev_port_set_rx_line_endings(UART_NUM_0, ESP_LINE_ENDINGS_LF);
  uart_vfs_dev_port_set_tx_line_endings(UART_NUM_0, ESP_LINE_ENDINGS_LF);

  g_vector_queue = xQueueCreate(2, sizeof(WorkItem));
  g_result_queue = xQueueCreate(2, sizeof(Result));
  if (!g_vector_queue || !g_result_queue) {
    ESP_LOGE("main", "queue alloc failed -- halting");
    return;
  }

  // infer_task carries the TFLite-Micro Invoke() stack usage, so give it room.
  xTaskCreate(infer_task, "infer", 16384, nullptr, 5, nullptr);
  xTaskCreate(rx_task, "rx", 4096, nullptr, 6, nullptr);
  xTaskCreate(tx_task, "tx", 4096, nullptr, 6, nullptr);
  // app_main returns; the three tasks keep running.
}
